## components/frame/Kconfig.projbuild
```kconfig
menu "Frame Configuration"


    config FRM_LOG_LEVEL
        int "Frame LOG LEVEL"
        range 0	5
        default 2
        help
        	Set LOG Level for FRAME module
        	0=None
        	1=Error
        	2=Warn
        	3=Info
        	4=Debug
        	5=Verbose

    config FRM_MIN_TX_DELAY
        int "Minimum delay before TX (mS)"
        range 0 100
        default	50
        help
            Specifies the minimum delay after any RX or TX frame before next TX

    config FRM_MAX_CAL_INTERVAL
        int "Maximum interval between cc1101 calibrations (sec)"
        range 0 300
        default	30
        help
            Specifies the maximum interval between cc1101 calibrations

    config UART_LOG_LEVEL
        int "UART LOG LEVEL"
        range 0	5
        default 2
        help
        	Set LOG Level for UART module
        	0=None
        	1=Error
        	2=Warn
        	3=Info
        	4=Debug
        	5=Verbose

    choice UART_NUM
        prompt "UART number selection"
        default UART_NUM_1 if IDF_TARGET_ESP32S3
        default UART_NUM_1 if IDF_TARGET_ESP32C6
        help
            Select the UART number for your board
        config UART_NUM_0
            bool "UART NUM 0"
        config UART_NUM_1
            bool "UART NUM 1"
    endchoice

    choice BAUD_RATE
        prompt "Baud rate selection"
        default RATE_38400 if IDF_TARGET_ESP32S3
        default RATE_38400 if IDF_TARGET_ESP32C6
        help
            Select the UART number for your board
        config RATE_38400
            bool "RATE 38400"
    endchoice

endmenu
```

## components/ramses-debug/Kconfig.projbuild
```kconfig
menu "Debug Configuration"
    config DEBUG_PIN1
        int "Debug pin 1"
        range 0	GPIO_RANGE_MAX
        default 6 if IDF_TARGET_ESP32S3
        default 0 if IDF_TARGET_ESP32C6
        help
        	Debug Pin 1 GPIO
        	0=Disable
        	6-11=GPIO

    config DEBUG_PIN2
        int "Debug pin 2"
        range 0	GPIO_RANGE_MAX
        default 7 if IDF_TARGET_ESP32S3
        default 1 if IDF_TARGET_ESP32C6
        help
        	Debug Pin 2 GPIO
        	0=Disable
        	6-11=GPIO
        	
    config DEBUG_PIN3
        int "Debug pin 3"
        range 0	GPIO_RANGE_MAX
        default 8 if IDF_TARGET_ESP32S3
        default 2 if IDF_TARGET_ESP32C6
        help
        	Debug Pin 3 GPIO
        	0=Disable
        	6-11=GPIO

    config DEBUG_PIN4
        int "Debug pin 4"
        range 0	GPIO_RANGE_MAX
        default 9 if IDF_TARGET_ESP32S3
        default 3 if IDF_TARGET_ESP32C6
        help
        	Debug Pin 1 GPIO
        	0=Disable
        	6-11=GPIO

    config DEBUG_PIN5
        int "Debug pin 5"
        range 0	GPIO_RANGE_MAX
        default 10 if IDF_TARGET_ESP32S3
        default 4 if IDF_TARGET_ESP32C6
        help
        	Debug Pin 5 GPIO
        	0=Disable
        	6-11=GPIO

    config DEBUG_PIN6
        int "Debug pin 6"
        range 0	GPIO_RANGE_MAX
        default 11 if IDF_TARGET_ESP32S3
        default 5 if IDF_TARGET_ESP32C6
        help
        	Debug Pin 6 GPIO
        	0=Disable
        	6-11=GPIO

endmenu
```

## components/ramses-led/Kconfig.projbuild
```kconfig
menu "LED Configuration"
    config GPIO_RX_LED
		int "RX LED GPIO"
        range 0 GPIO_RANGE_MAX
		default 42 if IDF_TARGET_ESP32S3
        default 19 if IDF_TARGET_ESP32C6
        help
        	GPIOx for RX LED

	config GPIO_TX_LED
		int "TX LED GPIO"
        range 0 GPIO_RANGE_MAX
		default 41 if IDF_TARGET_ESP32S3
        default 19 if IDF_TARGET_ESP32C6
        help
        	GPIOx for TX LED
  		
endmenu
```

## src/Kconfig.projbuild
```kconfig
# put here your custom config value
menu "RAMSES_ESP configuration"

    config RADIO_CORE
      int "Core for Radio Task"
      range 0 1 if IDF_TARGET_ESP32S3
      range 0 0 if IDF_TARGET_ESP32C6
      default 1 if IDF_TARGET_ESP32S3
      default 0 if IDF_TARGET_ESP32C6
      help
        The Radio task will run on this core.

    config HOST_CORE
      int "Core for Host Task"
      range 0 1
      default 0 if IDF_TARGET_ESP32S3
      default 0 if IDF_TARGET_ESP32C6
      help
        The Host task will run on this core.

    config FUNCTION_PIN
      int "Function Button GPIO pin"
      range 0 48 if IDF_TARGET_ESP32S3
      range 0 23 if IDF_TARGET_ESP32C6
      default 0 if IDF_TARGET_ESP32S3
      default 9 if IDF_TARGET_ESP32C6
      help
        GPIO pin number of Function Button

    config CS_PLATFORM_PIN
      int "CS Pin"
      range 0 41
      default 12 if IDF_TARGET_ESP32S3
      default 23 if IDF_TARGET_ESP32C6
      help
        GPIOx for CS Platform

    config RESTART_DELAY
      int "Restart Delay (seconds)"
      range 10 30
      default 15
      help
        Function button hold for restart duration.

endmenu
```
